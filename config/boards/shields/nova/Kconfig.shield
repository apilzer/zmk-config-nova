## config/boards/shields/nova/Kconfig.shield
```kconfig
config SHIELD_NOVA_LEFT
    def_bool $(shields_list_contains,node_left)

config SHIELD_NOVA_RIGHT
    def_bool $(shields_list_contains,node_right)
```
